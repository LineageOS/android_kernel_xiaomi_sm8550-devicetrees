/dts-v1/;
/plugin/;

#include <dt-bindings/interrupt-controller/arm-gic.h>
#include <dt-bindings/clock/qcom,gcc-anorak.h>
#include <dt-bindings/interconnect/qcom,anorak.h>
#include <dt-bindings/clock/qcom,videocc-anorak.h>
#include "anorak-vidc.dtsi"

/ {
	model = "Qualcomm Technologies, Inc. Anorak";
	compatible = "qcom,anorak";
	qcom,msm-id = <549 0x10000>;
	qcom,board-id = <0 0>, <33 0>, <34 0>, <0x10026 0x0>;
};
