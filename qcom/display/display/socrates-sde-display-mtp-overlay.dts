/dts-v1/;
/plugin/;

#include "socrates-sde-display-mtp.dtsi"

/ {
	model = "Qualcomm Technologies, Inc. 8550 socrates";
	compatible = "qcom,kalama-mtp", "qcom,kalama", "qcom,mtp";
	qcom,msm-id = <519 0x10000>, <536 0x10000>, <519 0x20000>, <536 0x20000>,<604 0x20000>;
	qcom,board-id = <0x10008 0>, <0x02010008 0x2>;
	xiaomi,miboard-id = <0x4 0>;
};
