			timing@wqhd_ddic_auto_minfps_1hz_index_07 {
				#include "dsi-panel-m2-38-0c-0a-dsc-cmd-common.dtsi"
				cell-index = <7>;
				qcom,mdss-dsi-panel-framerate = <120>;
				qcom,mdss-dsi-panel-width = <1440>;
				qcom,mdss-dsi-panel-height = <3200>;
				qcom,mdss-dsi-h-front-porch = <32>;
				qcom,mdss-dsi-h-back-porch = <32>;
				qcom,mdss-dsi-h-pulse-width = <16>;
				qcom,mdss-dsi-v-back-porch = <24>;
				qcom,mdss-dsi-v-front-porch = <24>;
				qcom,mdss-dsi-v-pulse-width = <8>;
				qcom,mdss-dsi-h-sync-pulse = <0>;
				qcom,mdss-dsi-h-left-border = <0>;
				qcom,mdss-dsi-h-right-border = <0>;
				qcom,mdss-dsi-v-top-border = <0>;
				qcom,mdss-dsi-v-bottom-border = <0>;
				qcom,mdss-dsi-panel-clockrate = <1360000000>;
				qcom,mdss-dsi-panel-jitter = <0x5 0x1>;
				qcom,mdss-mdp-transfer-time-us = <7300>;

				/* ---------------------------- */
				/* | 15 - 14 | 13 - 7 | 6 - 0 | */
				/* ---------------------------- */
				/* |   mode  | sf fps | min fps| */
				/* ---------------------------- -*/
				/* mode: 1 idle, 2 auto, 3 qsync */
				/*   2 << 14 | 120 << 7 | 1     */
				qcom,mdss-dsi-h-sync-skew = <48129>;

				qcom,mdss-dsi-timing-switch-command = [
					/* CASET/PASET Setting 1440*3200 */
					39 00 00 40 00 00 05 2A 00 00 05 9F
					39 00 00 40 00 00 05 2B 00 00 0C 7F
					/* Scaler Setting 1440*3200 */
					39 00 00 40 00 00 03 F0 5A 5A
					39 00 00 40 00 00 02 C3 0C
					39 00 00 40 00 00 03 F0 A5 A5
					/* FIX TE ON */
					39 00 00 40 00 00 03 F0 5A 5A
					15 00 00 40 00 00 02 B9 41
					39 00 00 40 00 00 04 B0 00 06 B9
					39 00 00 40 00 00 07 B9 0C 9E 0C 9E 00 1D
					39 00 00 40 00 00 02 F7 0F
					39 00 00 40 00 00 03 F0 A5 A5
					/* 1Hz Setting(force increasing on) */
					39 00 00 40 00 00 03 F0 5A 5A
					39 00 00 40 00 00 04 B0 00 08 CB
					39 00 00 40 00 00 02 CB 12
					39 00 00 40 00 00 03 BD 21 02     /* Auto mode On, Dynamic update, index 14 */
					39 00 00 40 00 00 04 B0 00 10 BD
					39 00 00 40 00 00 02 BD 00
					39 00 00 40 00 00 04 B0 00 21 BD
					39 00 00 40 00 00 0F BD 01 00 02 00 03 00 04 00 05 00 07 00 0B 00
					39 00 00 40 00 00 04 B0 00 61 BD
					39 00 00 40 00 00 0A BD 01 00 02 00 03 00 04 00 1D
					39 00 00 40 00 00 04 B0 00 12 BD
					39 00 00 40 00 00 02 BD 00
					39 00 00 40 00 00 02 BD 23   /* Control in Auto mode */
					39 00 00 40 00 00 04 B0 00 14 BD
					39 00 00 40 00 00 02 BD 77        /* 0B:10hz, 77:1hz */
					39 00 00 40 00 00 04 B0 00 16 BD
					39 00 00 40 00 00 03 BD 02 00
					39 00 00 40 00 00 02 F7 0F
					39 00 00 00 00 00 03 F0 A5 A5
				];
				qcom,mdss-dsi-timing-switch-command-update = <0xBD 14 2>;
				qcom,mdss-dsi-timing-switch-command-state = "dsi_hs_mode";

				qcom,mdss-dsi-on-command = [
					/* DSC PPS Setting */
					39 00 00 00 00 00 81 9E
						12 00 00 AB 30 80 0C 80 05 A0 00 19 02 D0 02 D0
						02 00 02 86 00 20 02 9E 00 0A 00 0D 04 56 03 0D
						18 00 10 F0 07 10 20 00 06 0F 0F 33 0E 1C 2A 38
						46 54 62 69 70 77 79 7B 7D 7E 02 02 22 00 2A 40
						2A BE 3A FC 3A FA 3A F8 3B 38 3B 78 3B B6 4B B6
						4B F4 4B F4 6C 34 84 74 00 00 00 00 00 00 00 00
						00 00 00 00 00 00 00 00 00 00 00 00 00 00 00 00
						00 00 00 00 00 00 00 00 00 00 00 00 00 00 00 00
					/* DSC Compression Enable */
					15 00 00 00 00 00 02 9D 01
					/* Sleep Out */
					05 00 00 00 78 00 02 11 00
					/* Common Setting */
					/* TE(Vsync) On */
					15 00 00 00 00 00 02 35 00
					/* CASET/PASET Setting 1440*3200 */
					39 00 00 00 00 00 05 2A 00 00 05 9F
					39 00 00 00 00 00 05 2B 00 00 0C 7F
					/* Scaler Setting 1440*3200 */
					39 00 00 40 00 00 03 F0 5A 5A
					15 00 00 40 00 00 02 C3 0C    /* 0x0C:WQHD+(1440x3200), 0x0D:FHD+(1080x2400) */
					39 00 00 00 00 00 03 F0 A5 A5
					/* FIX TE ON */
					39 00 00 40 00 00 03 F0 5A 5A
					15 00 00 40 00 00 02 B9 41
					39 00 00 40 00 00 04 B0 00 06 B9
					39 00 00 40 00 00 07 B9 0C 9E 0C 9E 00 1D
					39 00 00 40 00 00 02 F7 0F
					39 00 00 00 00 00 03 F0 A5 A5
					/* 1Hz Setting(force increasing on) */
					39 00 00 40 00 00 03 F0 5A 5A
					39 00 00 40 00 00 04 B0 00 08 CB
					39 00 00 40 00 00 02 CB 12
					39 00 00 40 00 00 03 BD 21 02    /* Auto mode On */
					39 00 00 40 00 00 04 B0 00 10 BD
					39 00 00 40 00 00 02 BD 00
					39 00 00 40 00 00 04 B0 00 21 BD
					39 00 00 40 00 00 0F BD 01 00 02 00 03 00 04 00 05 00 07 00 0B 00
					39 00 00 40 00 00 04 B0 00 61 BD
					39 00 00 40 00 00 0A BD 01 00 02 00 03 00 04 00 1D
					39 00 00 40 00 00 04 B0 00 12 BD
					39 00 00 40 00 00 02 BD 00
					39 00 00 40 00 00 02 60 03
					39 00 00 40 00 00 04 B0 00 16 BD
					39 00 00 40 00 00 03 BD 02 00
					39 00 00 40 00 00 02 F7 0F
					39 00 00 00 00 00 03 F0 A5 A5
					/* Dimming Setting */
					39 00 00 40 00 00 03 F0 5A 5A
					39 00 00 40 00 00 04 B0 00 0D 63
					/* Dimming Speed: 8 frame */
					15 00 00 40 00 00 02 63 08
					39 00 00 40 00 00 04 B0 00 0C 63
					/* Elvss dimming 0FF */
					15 00 00 40 00 00 02 63 20
					39 00 00 40 00 00 03 F0 A5 A5
					/* Dimming OFF */
					15 00 00 40 00 00 02 53 20
					39 00 00 40 00 00 03 51 00 00
					39 00 00 40 00 00 02 F7 0F
					/* ESD Error Flag, Normal High, Error Low */
					39 00 00 40 00 00 03 F0 5A 5A
					39 00 00 40 00 00 04 B0 00 47 F4
					15 00 00 40 00 00 02 F4 01
					39 00 00 40 00 00 04 ED 44 05 20
					39 00 00 00 00 00 03 F0 A5 A5
					/* touch sync enable */
					39 00 00 40 00 00 03 F0 5A 5A
					39 00 00 40 00 00 03 F1 5A 5A
					39 00 00 40 00 00 04 B0 00 22 B9
					39 00 00 40 00 00 03 B9 B1 A1
					39 00 00 40 00 00 04 B0 00 05 F2
					15 00 00 40 00 00 02 F2 52
					15 00 00 40 00 00 02 F7 0F
					39 00 00 40 00 00 03 F1 A5 A5
					39 00 00 40 00 00 03 F0 A5 A5
					39 00 00 40 00 00 03 F0 5A 5A
					39 00 00 40 00 00 02 C3 0C
					39 00 00 00 00 00 03 F0 A5 A5
					/* DIA setting */
					39 00 00 40 00 00 03 F0 5A 5A
					39 00 00 40 00 00 04 B0 02 67 1D
					39 00 00 40 00 00 02 1D 81
					39 00 00 00 00 00 03 F0 A5 A5
					/* OPEC code */
					39 00 00 40 00 00 03 F0 5A 5A
					39 00 00 40 00 00 04 B0 00 52 1F
					39 00 00 40 00 00 02 1F 02
					39 00 00 40 00 00 04 B0 00 53 1F
					39 00 00 40 00 00 5F 1F
						07 01 00 02 B9 02 BA 07 A2 07 AA 12 C0 12 C1 1A
						BA 1B C0 1F E0 00 53 00 C3 03 43 07 A0 07 A1 07
						A2 07 A6 07 A8 07 AA 07 AC 07 AE 07 B0 07 B2 07
						B4 07 B6 00 03 00 A4 00 C0 00 D1 01 86 03 FF 07
						FF 30 30 35 40 35 30 40 40 35 80 80 80 0A 0F 14
						18 1E 3A 78 80 80 80 80 80 80 80 80 01 B1
					39 00 00 40 00 00 04 B0 00 78 BD
					39 00 00 40 00 00 02 BD 10
					39 00 00 00 00 00 02 F7 0F
					39 00 00 00 00 00 03 F0 A5 A5
					/* Display On */
					05 00 00 00 00 00 02 29 00
					39 00 00 40 00 00 03 F0 5A 5A
					39 00 00 40 00 00 02 BD 23   /* Control in Auto mode */
					39 00 00 40 00 00 04 B0 00 14 BD
					39 00 00 40 00 00 02 BD 77        /* 0B:10hz, 77:1hz */
					39 00 00 40 00 00 02 F7 0F
					39 00 00 00 00 00 03 F0 A5 A5
				];
				qcom,mdss-dsi-on-command-state = "dsi_lp_mode";

				qcom,mdss-dsi-nolp-command = [
					39 00 00 40 00 00 03 F0 5A 5A
					15 00 00 40 00 00 02 53 20
					39 00 00 40 00 00 03 51 00 00
					39 00 00 00 22 00 03 F0 A5 A5
					/* FIX TE ON */
					39 00 00 40 00 00 03 F0 5A 5A
					15 00 00 40 00 00 02 B9 41
					39 00 00 40 00 00 04 B0 00 06 B9
					39 00 00 40 00 00 07 B9 0C 9E 0C 9E 00 1D
					39 00 00 40 00 00 02 F7 0F
					39 00 00 40 00 00 03 F0 A5 A5
					/* 1Hz Setting(force increasing on) */
					39 00 00 40 00 00 03 F0 5A 5A
					39 00 00 40 00 00 04 B0 03 37 65
					15 00 00 40 00 00 02 65 04
					39 00 00 40 00 00 04 B0 00 08 CB
					39 00 00 40 00 00 02 CB 12
					39 00 00 40 00 00 03 BD 21 0F    /* Auto mode On */
					39 00 00 40 00 00 04 B0 00 10 BD
					39 00 00 40 00 00 02 BD 00
					39 00 00 40 00 00 04 B0 00 21 BD
					39 00 00 40 00 00 0F BD 01 00 02 00 03 00 04 00 05 00 07 00 0B 00
					39 00 00 40 00 00 04 B0 00 61 BD
					39 00 00 40 00 00 0A BD 01 00 02 00 03 00 04 00 1D
					39 00 00 40 00 00 04 B0 00 12 BD
					39 00 00 40 00 00 02 BD 00
					39 00 00 40 00 00 02 BD 23   /* Control in Auto mode */
					39 00 00 40 00 00 04 B0 00 14 BD
					39 00 00 40 00 00 02 BD 77        /* 0B:10hz, 77:1hz */
					39 00 00 40 00 00 04 B0 00 16 BD
					39 00 00 40 00 00 03 BD 02 00
					39 00 00 40 00 00 02 F7 0F
					39 00 00 00 00 00 03 F0 A5 A5
				];
				qcom,mdss-dsi-nolp-command-update = <0x51 2 2>;
				qcom,mdss-dsi-nolp-command-state = "dsi_lp_mode";

				mi,mdss-dsi-doze-hbm-command = [
					/* 120Hz Setting(force increasing off) */
					39 00 00 40 00 00 03 F0 5A 5A
					39 00 00 40 00 00 04 B0 00 08 CB
					39 00 00 40 00 00 02 CB 12
					39 00 00 40 00 00 03 BD 21 8F
					39 00 00 40 00 00 04 B0 00 10 BD
					39 00 00 40 00 00 02 BD 00
					39 00 00 40 00 00 04 B0 00 21 BD
					39 00 00 40 00 00 0F BD 10 00 20 00 30 00 40 00 50 00 70 00 B0 00
					39 00 00 40 00 00 04 B0 00 61 BD
					39 00 00 40 00 00 0A BD 04 00 08 00 0C 00 10 00 74
					39 00 00 40 00 00 04 B0 00 12 BD
					39 00 00 40 00 00 02 BD 01
					39 00 00 40 00 00 04 B0 00 16 BD
					39 00 00 40 00 00 03 BD 00 00    /* Step delay */
					39 00 00 40 00 00 02 BD 21       /* Manual mode */
					39 00 00 40 00 00 02 60 00       /* 0x00:120Hz, 0x01:60Hz, 0x03:30Hz, 0x07:10Hz */
					39 00 00 40 00 00 02 F7 0F
					39 00 00 00 09 00 03 F0 A5 A5
					/* AOD setting */
					39 00 00 20 00 00 03 51 07 0A    /* Dynamic update, index 18 */
					39 00 00 40 00 00 03 F0 5A 5A
					39 00 00 40 00 00 02 BB 31
					39 00 00 40 00 00 02 F7 0F
					39 00 00 40 00 00 02 53 24
					39 00 00 00 00 00 03 51 07 FE
				];
				mi,mdss-dsi-doze-hbm-command-update = <0x51 18 2>;
				mi,mdss-dsi-doze-hbm-command-state = "dsi_lp_mode";
				mi,mdss-dsi-doze-lbm-command = [
					/* 120Hz Setting(force increasing off) */
					39 00 00 40 00 00 03 F0 5A 5A
					39 00 00 40 00 00 04 B0 00 08 CB
					39 00 00 40 00 00 02 CB 12
					39 00 00 40 00 00 03 BD 21 8F
					39 00 00 40 00 00 04 B0 00 10 BD
					39 00 00 40 00 00 02 BD 00
					39 00 00 40 00 00 04 B0 00 21 BD
					39 00 00 40 00 00 0F BD 10 00 20 00 30 00 40 00 50 00 70 00 B0 00
					39 00 00 40 00 00 04 B0 00 61 BD
					39 00 00 40 00 00 0A BD 04 00 08 00 0C 00 10 00 74
					39 00 00 40 00 00 04 B0 00 12 BD
					39 00 00 40 00 00 02 BD 01
					39 00 00 40 00 00 04 B0 00 16 BD
					39 00 00 40 00 00 03 BD 00 00    /* Step delay */
					39 00 00 40 00 00 02 BD 21       /* Manual mode */
					39 00 00 40 00 00 02 60 00       /* 0x00:120Hz, 0x01:60Hz, 0x03:30Hz, 0x07:10Hz */
					39 00 00 40 00 00 02 F7 0F
					39 00 00 00 09 00 03 F0 A5 A5
					/* AOD setting */
					39 00 00 20 00 00 03 51 07 0A    /* Dynamic update, index 18 */
					39 00 00 40 00 00 03 F0 5A 5A
					39 00 00 40 00 00 02 BB 31
					39 00 00 40 00 00 02 F7 0F
					39 00 00 40 00 00 02 53 24
					39 00 00 00 00 00 03 51 00 F6
				];
				mi,mdss-dsi-doze-lbm-command-update = <0x51 18 2>;
				mi,mdss-dsi-doze-lbm-command-state = "dsi_lp_mode";

				mi,mdss-dsi-doze-hbm-nolp-command = [
					/* aod off */
					39 00 00 40 00 00 02 53 20
					39 00 00 00 00 00 03 51 00 F5
					/* 16 pulse on */
					39 00 00 40 00 00 03 F0 5A 5A
					39 00 00 40 00 00 04 B0 03 37 65
					15 00 00 40 00 00 02 65 04
					39 00 00 40 00 00 03 BD 21 8F
					39 00 00 40 00 00 04 B0 00 21 BD
					39 00 00 40 00 00 0F BD 10 00 20 00 30 00 40 00 50 00 70 00 B0 00
					39 00 00 40 00 00 04 B0 00 0C 63
					39 00 00 40 00 00 02 63 20
					39 00 00 40 00 00 03 BD 21 8F
					15 00 00 40 00 00 02 F7 0F
					39 00 00 00 00 00 03 F0 A5 A5
				];
				mi,mdss-dsi-doze-hbm-nolp-command-state = "dsi_lp_mode";

				mi,mdss-dsi-doze-lbm-nolp-command = [
					/* aod off */
					15 00 00 40 00 00 02 53 20
					39 00 00 00 00 00 03 51 00 14
					/* 16 pulse on */
					39 00 00 40 00 00 03 F0 5A 5A
					39 00 00 40 00 00 04 B0 03 37 65
					15 00 00 40 00 00 02 65 04
					39 00 00 40 00 00 03 BD 21 8F
					39 00 00 40 00 00 04 B0 00 21 BD
					39 00 00 40 00 00 0F BD 10 00 20 00 30 00 40 00 50 00 70 00 B0 00
					39 00 00 40 00 00 04 B0 00 0C 63
					39 00 00 40 00 00 02 63 20
					39 00 00 40 00 00 03 BD 21 8F
					15 00 00 40 00 00 02 F7 0F
					39 00 00 00 00 00 03 F0 A5 A5
				];
				mi,mdss-dsi-doze-lbm-nolp-command-state = "dsi_lp_mode";
				mi,mdss-dsi-local-hbm-hlpm-white-1000nit-command = [
					/* nolp */
					39 00 00 40 00 00 03 F0 5A 5A
					39 00 00 40 00 00 02 53 20
					39 00 00 00 22 00 03 F0 A5 A5
					/* Local HBM setting */
					39 00 00 40 00 00 03 F0 5A 5A
					39 00 00 40 00 00 04 B0 01 DC 1F
					39 00 00 40 00 00 10 1F 02 00 00 00 00 24
						09 5D 35 FA 7C 2D 09 ED 7B
					39 00 00 40 00 00 04 B0 02 AC 66
					39 00 00 40 00 00 03 66 0F FF
					39 00 00 40 00 00 04 B0 01 6D 66
					39 00 00 40 00 00 13 66 00 40 14 02 90 52
						0A 41 48 1C 27 FF FF FF FF FF FF FF
					39 00 00 40 00 00 04 B0 01 59 66
					39 00 00 40 00 00 06 66 09 8B 40 A0 54 		/* 1300 nit*/
					39 00 00 40 00 00 04 B0 01 B5 66
					39 00 00 40 00 00 37 66 14 F1 F9 2B 23 B6 51
						46 F4 80 08 00 80 08 00 80 08 00 14 F1 F9 2B
						23 B6 51 46 F4 80 08 00 80 08 00 80 08 00 14
						F1 F9 2B 23 B6 51 46 F4 80 08 00 80 08 00 80 08 00
					39 00 00 40 00 00 04 B0 01 EB 66
					39 00 00 40 00 00 37 66 14 F1 F9 2B 23 B6 51
						46 F4 80 08 00 80 08 00 80 08 00 14 F1 F9 2B
						23 B6 51 46 F4 80 08 00 80 08 00 80 08 00 14
						F1 F9 2B 23 B6 51 46 F4 80 08 00 80 08 00 80 08 00
					39 00 00 40 00 00 04 B0 01 EB 66
					39 00 00 40 00 00 37 66 14 F1 F9 2B 23 B6 51
						46 F4 80 08 00 80 08 00 80 08 00 14 F1 F9 2B
						23 B6 51 46 F4 80 08 00 80 08 00 80 08 00 14
						F1 F9 2B 23 B6 51 46 F4 80 08 00 80 08 00 80 08 00
					39 00 00 40 00 00 02 53 30   /* 0x30 Local HBM transition */
					/* 16 pulse off */
					39 00 00 40 00 00 04 B0 00 0D 63
					39 00 00 40 00 00 02 63 08
					39 00 00 40 00 00 04 B0 00 0C 63
					39 00 00 40 00 00 02 63 20
					39 00 00 40 00 00 04 B0 03 37 65
					39 00 00 40 00 00 02 65 01
					39 00 00 40 00 00 03 BD 21 82
					39 00 00 40 00 00 04 B0 00 21 BD
					39 00 00 40 00 00 02 53 30
					39 00 00 40 00 00 02 F7 0F
					39 00 00 00 10 00 03 F0 A5 A5
				];
				mi,mdss-dsi-local-hbm-hlpm-white-1000nit-command-state = "dsi_hs_mode";

				mi,mdss-dsi-local-hbm-hlpm-white-110nit-command = [
					/* nolp */
					39 00 00 40 00 00 03 F0 5A 5A
					39 00 00 40 00 00 02 53 20
					39 00 00 00 22 00 03 F0 A5 A5
					/* Local HBM setting */
					39 00 00 40 00 00 03 F0 5A 5A
					39 00 00 40 00 00 04 B0 01 DC 1F
					39 00 00 40 00 00 10 1F 02 00 00 00 00 24
						09 5D 35 FA 7C 2D 09 ED 7B
					39 00 00 40 00 00 04 B0 02 AC 66
					39 00 00 40 00 00 03 66 0F FF
					39 00 00 40 00 00 04 B0 01 6D 66
					39 00 00 40 00 00 13 66 00 40 14 02 90 52
						0A 41 48 1C 27 FF FF FF FF FF FF FF
					39 00 00 40 00 00 04 B0 01 59 66
					39 00 00 40 00 00 06 66 06 67 C9 7E F5 		/* 250 nit*/
					39 00 00 40 00 00 04 B0 01 B5 66
					39 00 00 40 00 00 37 66 14 F1 F9 2B 23 B6 51
						46 F4 80 08 00 80 08 00 80 08 00 14 F1 F9 2B
						23 B6 51 46 F4 80 08 00 80 08 00 80 08 00 14
						F1 F9 2B 23 B6 51 46 F4 80 08 00 80 08 00 80 08 00
					39 00 00 40 00 00 04 B0 01 EB 66
					39 00 00 40 00 00 37 66 14 F1 F9 2B 23 B6 51
						46 F4 80 08 00 80 08 00 80 08 00 14 F1 F9 2B
						23 B6 51 46 F4 80 08 00 80 08 00 80 08 00 14
						F1 F9 2B 23 B6 51 46 F4 80 08 00 80 08 00 80 08 00
					39 00 00 40 00 00 04 B0 01 EB 66
					39 00 00 40 00 00 37 66 14 F1 F9 2B 23 B6 51
						46 F4 80 08 00 80 08 00 80 08 00 14 F1 F9 2B
						23 B6 51 46 F4 80 08 00 80 08 00 80 08 00 14
						F1 F9 2B 23 B6 51 46 F4 80 08 00 80 08 00 80 08 00
					39 00 00 40 00 00 02 53 30   /* 0x30 Local HBM transition */
					/* 16 pulse off */
					39 00 00 40 00 00 04 B0 00 0D 63
					39 00 00 40 00 00 02 63 08
					39 00 00 40 00 00 04 B0 00 0C 63
					39 00 00 40 00 00 02 63 20
					39 00 00 40 00 00 04 B0 03 37 65
					39 00 00 40 00 00 02 65 01
					39 00 00 40 00 00 03 BD 21 82
					39 00 00 40 00 00 04 B0 00 21 BD
					39 00 00 40 00 00 02 53 30
					39 00 00 40 00 00 02 F7 0F
					39 00 00 00 10 00 03 F0 A5 A5
				];
				mi,mdss-dsi-local-hbm-hlpm-white-110nit-command-state = "dsi_hs_mode";
				mi,mdss-dsi-hbm-on-command = [
					39 00 00 40 00 00 03 F0 5A 5A
					/* ELVSS DIM ON */
					39 00 00 40 00 00 04 B0 00 0C 63
					15 00 00 40 00 00 02 63 30
					/* Dimming On and wait one frame*/
					15 00 00 40 00 00 02 53 28    /* Dynamic update, index 3 */
					/* WRDISBV */
					39 00 00 00 09 00 03 51 07 FF   /* Dynamic update, index 4 */
					/* HBM Mode Setting */
					39 00 00 40 00 00 04 B0 00 01 49
					15 00 00 40 00 00 02 49 00
					39 00 00 00 00 00 03 F0 A5 A5
				];
				/* <mipi_address  update_index  update_length> */
				mi,mdss-dsi-hbm-on-command-update = <0x53 3 1>,<0x51 4 2>;
				mi,mdss-dsi-hbm-on-command-state = "dsi_lp_mode";
				mi,mdss-dsi-hbm-off-command = [
					39 00 00 60 00 00 03 F0 5A 5A
					/* ELVSS DIM OFF */
					39 00 00 60 00 00 04 B0 00 0C 63
					39 00 00 60 00 00 02 63 20
					39 00 00 60 00 00 02 53 20   /* Dynamic update, index 3 */
					39 00 00 20 05 00 03 51 07 FF
					39 00 00 60 00 00 03 F0 5A 5A
					/* HBM Mode Setting */
					39 00 00 60 00 00 04 B0 00 01 49
					39 00 00 60 00 00 02 49 01
					39 00 00 60 00 00 03 51 07 FF    /* Dynamic update, index 8 */
					39 00 00 20 00 00 03 F0 A5 A5
				];
				/* <mipi_address  update_index  update_length> */
				mi,mdss-dsi-hbm-off-command-update = <0x53 3 1>,<0x51 8 2>;
				mi,mdss-dsi-hbm-off-command-state = "dsi_lp_mode";

				mi,mdss-dsi-panel-em-cycle-16pulse-on-command = [
					39 00 00 40 00 00 03 F0 5A 5A
					39 00 00 40 00 00 03 BD 21 8F     /* Dynamic update, index 1 */
					39 00 00 40 00 00 04 B0 00 21 BD
					39 00 00 40 00 00 0F BD 10 00 20 00 30 00 40 00 50 00 70 00 B0 00  /* Dynamic update, index 3 */
					39 00 00 40 00 00 04 B0 00 0C 63
					39 00 00 40 00 00 02 63 20
					39 00 00 40 00 00 04 B0 03 37 65
					15 00 00 40 00 00 02 65 04
					39 00 00 40 00 00 03 BD 21 8F    /* Dynamic update, index 8 */
					39 00 00 40 00 00 03 51 01 48    /* Dynamic update, index 9 */
					15 00 00 40 00 00 02 F7 0F
					39 00 00 00 08 00 03 F0 A5 A5
				];
				mi,mdss-dsi-panel-em-cycle-16pulse-on-command-update = <0xBD 1 2>,<0xBD 3 14>,<0xBD 8 2>,<0x51 9 2>;
				mi,mdss-dsi-panel-em-cycle-16pulse-on-command-state = "dsi_lp_mode";

				mi,mdss-dsi-panel-em-cycle-16pulse-off-command = [
					39 00 00 40 00 00 03 F0 5A 5A
					39 00 00 40 00 00 03 BD 21 82    /* Dynamic update, index 1 */
					39 00 00 40 00 00 04 B0 00 21 BD
					39 00 00 40 00 00 0F BD 03 00 06 00 09 00 0C 00 0F 00 15 00 21 00  /* Dynamic update, index 3 */
					39 00 00 40 00 00 04 B0 00 0C 63
					39 00 00 40 00 00 02 63 20
					39 00 00 40 00 00 04 B0 03 37 65
					15 00 00 40 00 00 02 65 01
					39 00 00 40 00 00 03 BD 21 82   /* Dynamic update, index 8 */
					39 00 00 40 00 00 03 51 01 49   /* Dynamic update, index 9 */
					15 00 00 40 00 00 02 F7 0F
					39 00 00 00 08 00 03 F0 A5 A5
				];
				mi,mdss-dsi-panel-em-cycle-16pulse-off-command-update =<0xBD 1 2>,<0xBD 3 14>,<0xBD 8 2>,<0x51 9 2>;
				mi,mdss-dsi-panel-em-cycle-16pulse-off-command-state = "dsi_lp_mode";

				qcom,compression-mode = "dsc";
				qcom,mdss-dsc-version = <0x12>;
				qcom,mdss-dsc-slice-height = <25>;
				qcom,mdss-dsc-slice-width = <720>;
				qcom,mdss-dsc-slice-per-pkt = <2>;
				qcom,mdss-dsc-bit-per-component = <10>;
				qcom,mdss-dsc-bit-per-pixel = <8>;
				qcom,mdss-dsc-block-prediction-enable;
			};
			timing@wqhd_ddic_auto_minfps_1hz_index_08 {
				#include "dsi-panel-m2-38-0c-0a-dsc-cmd-common.dtsi"
				cell-index = <8>;
				qcom,mdss-dsi-panel-framerate = <120>;
				qcom,mdss-dsi-panel-width = <1440>;
				qcom,mdss-dsi-panel-height = <3200>;
				qcom,mdss-dsi-h-front-porch = <32>;
				qcom,mdss-dsi-h-back-porch = <32>;
				qcom,mdss-dsi-h-pulse-width = <16>;
				qcom,mdss-dsi-v-back-porch = <24>;
				qcom,mdss-dsi-v-front-porch = <24>;
				qcom,mdss-dsi-v-pulse-width = <8>;
				qcom,mdss-dsi-h-sync-pulse = <0>;
				qcom,mdss-dsi-h-left-border = <0>;
				qcom,mdss-dsi-h-right-border = <0>;
				qcom,mdss-dsi-v-top-border = <0>;
				qcom,mdss-dsi-v-bottom-border = <0>;
				qcom,mdss-dsi-panel-clockrate = <1360000000>;
				qcom,mdss-dsi-panel-jitter = <0x5 0x1>;
				qcom,mdss-mdp-transfer-time-us = <7300>;

				/* ---------------------------- */
				/* | 15 - 14 | 13 - 7 | 6 - 0 | */
				/* ---------------------------- */
				/* |   mode  | sf fps | min fps| */
				/* ---------------------------- -*/
				/* mode: 1 idle, 2 auto, 3 qsync */
				/*   2 << 14 | 120 << 7 | 1     */
				qcom,mdss-dsi-h-sync-skew = <40449>;

				qcom,mdss-dsi-timing-switch-command = [
					/* CASET/PASET Setting 1440*3200 */
					39 00 00 40 00 00 05 2A 00 00 05 9F
					39 00 00 40 00 00 05 2B 00 00 0C 7F
					/* Scaler Setting 1440*3200 */
					39 00 00 40 00 00 03 F0 5A 5A
					39 00 00 40 00 00 02 C3 0C
					39 00 00 40 00 00 03 F0 A5 A5
					/* FIX TE ON */
					39 00 00 40 00 00 03 F0 5A 5A
					15 00 00 40 00 00 02 B9 41
					39 00 00 40 00 00 04 B0 00 06 B9
					39 00 00 40 00 00 07 B9 0C 9E 0C 9E 00 1D
					39 00 00 40 00 00 02 F7 0F
					39 00 00 40 00 00 03 F0 A5 A5
					/* 1Hz Setting(force increasing on) */
					39 00 00 40 00 00 03 F0 5A 5A
					39 00 00 40 00 00 04 B0 00 08 CB
					39 00 00 40 00 00 02 CB 12
					39 00 00 40 00 00 03 BD 21 02     /* Auto mode On, Dynamic update, index 14 */
					39 00 00 40 00 00 04 B0 00 10 BD
					39 00 00 40 00 00 02 BD 00
					39 00 00 40 00 00 04 B0 00 21 BD
					39 00 00 40 00 00 0F BD 01 00 02 00 03 00 04 00 05 00 07 00 0B 00
					39 00 00 40 00 00 04 B0 00 61 BD
					39 00 00 40 00 00 0A BD 01 00 02 00 03 00 04 00 1D
					39 00 00 40 00 00 04 B0 00 12 BD
					39 00 00 40 00 00 02 BD 00
					39 00 00 40 00 00 02 BD 23   /* Control in Auto mode */
					39 00 00 40 00 00 04 B0 00 14 BD
					39 00 00 40 00 00 02 BD 77        /* 0B:10hz, 77:1hz */
					39 00 00 40 00 00 04 B0 00 16 BD
					39 00 00 40 00 00 03 BD 02 00
					39 00 00 40 00 00 02 F7 0F
					39 00 00 00 00 00 03 F0 A5 A5
				];
				qcom,mdss-dsi-timing-switch-command-update = <0xBD 14 2>;
				qcom,mdss-dsi-timing-switch-command-state = "dsi_hs_mode";

				qcom,mdss-dsi-on-command = [
					/* DSC PPS Setting */
					39 00 00 00 00 00 81 9E
						12 00 00 AB 30 80 0C 80 05 A0 00 19 02 D0 02 D0
						02 00 02 86 00 20 02 9E 00 0A 00 0D 04 56 03 0D
						18 00 10 F0 07 10 20 00 06 0F 0F 33 0E 1C 2A 38
						46 54 62 69 70 77 79 7B 7D 7E 02 02 22 00 2A 40
						2A BE 3A FC 3A FA 3A F8 3B 38 3B 78 3B B6 4B B6
						4B F4 4B F4 6C 34 84 74 00 00 00 00 00 00 00 00
						00 00 00 00 00 00 00 00 00 00 00 00 00 00 00 00
						00 00 00 00 00 00 00 00 00 00 00 00 00 00 00 00
					/* DSC Compression Enable */
					15 00 00 00 00 00 02 9D 01
					/* Sleep Out */
					05 00 00 00 78 00 02 11 00
					/* Common Setting */
					/* TE(Vsync) On */
					15 00 00 00 00 00 02 35 00
					/* CASET/PASET Setting 1440*3200 */
					39 00 00 00 00 00 05 2A 00 00 05 9F
					39 00 00 00 00 00 05 2B 00 00 0C 7F
					/* Scaler Setting 1440*3200 */
					39 00 00 40 00 00 03 F0 5A 5A
					15 00 00 40 00 00 02 C3 0C    /* 0x0C:WQHD+(1440x3200), 0x0D:FHD+(1080x2400) */
					39 00 00 00 00 00 03 F0 A5 A5
					/* FIX TE ON */
					39 00 00 40 00 00 03 F0 5A 5A
					15 00 00 40 00 00 02 B9 41
					39 00 00 40 00 00 04 B0 00 06 B9
					39 00 00 40 00 00 07 B9 0C 9E 0C 9E 00 1D
					39 00 00 40 00 00 02 F7 0F
					39 00 00 00 00 00 03 F0 A5 A5
					/* 1Hz Setting(force increasing on) */
					39 00 00 40 00 00 03 F0 5A 5A
					39 00 00 40 00 00 04 B0 00 08 CB
					39 00 00 40 00 00 02 CB 12
					39 00 00 40 00 00 03 BD 21 02    /* Auto mode On */
					39 00 00 40 00 00 04 B0 00 10 BD
					39 00 00 40 00 00 02 BD 00
					39 00 00 40 00 00 04 B0 00 21 BD
					39 00 00 40 00 00 0F BD 01 00 02 00 03 00 04 00 05 00 07 00 0B 00
					39 00 00 40 00 00 04 B0 00 61 BD
					39 00 00 40 00 00 0A BD 01 00 02 00 03 00 04 00 1D
					39 00 00 40 00 00 04 B0 00 12 BD
					39 00 00 40 00 00 02 BD 00
					39 00 00 40 00 00 02 60 03
					39 00 00 40 00 00 04 B0 00 16 BD
					39 00 00 40 00 00 03 BD 02 00
					39 00 00 40 00 00 02 F7 0F
					39 00 00 00 00 00 03 F0 A5 A5
					/* Dimming Setting */
					39 00 00 40 00 00 03 F0 5A 5A
					39 00 00 40 00 00 04 B0 00 0D 63
					/* Dimming Speed: 8 frame */
					15 00 00 40 00 00 02 63 08
					39 00 00 40 00 00 04 B0 00 0C 63
					/* Elvss dimming 0FF */
					15 00 00 40 00 00 02 63 20
					39 00 00 40 00 00 03 F0 A5 A5
					/* Dimming OFF */
					15 00 00 40 00 00 02 53 20
					39 00 00 40 00 00 03 51 00 00
					39 00 00 40 00 00 02 F7 0F
					/* ESD Error Flag, Normal High, Error Low */
					39 00 00 40 00 00 03 F0 5A 5A
					39 00 00 40 00 00 04 B0 00 47 F4
					15 00 00 40 00 00 02 F4 01
					39 00 00 40 00 00 04 ED 44 05 20
					39 00 00 00 00 00 03 F0 A5 A5
					/* touch sync enable */
					39 00 00 40 00 00 03 F0 5A 5A
					39 00 00 40 00 00 03 F1 5A 5A
					39 00 00 40 00 00 04 B0 00 22 B9
					39 00 00 40 00 00 03 B9 B1 A1
					39 00 00 40 00 00 04 B0 00 05 F2
					15 00 00 40 00 00 02 F2 52
					15 00 00 40 00 00 02 F7 0F
					39 00 00 40 00 00 03 F1 A5 A5
					39 00 00 40 00 00 03 F0 A5 A5
					39 00 00 40 00 00 03 F0 5A 5A
					39 00 00 40 00 00 02 C3 0C
					39 00 00 00 00 00 03 F0 A5 A5
					/* DIA setting */
					39 00 00 40 00 00 03 F0 5A 5A
					39 00 00 40 00 00 04 B0 02 67 1D
					39 00 00 40 00 00 02 1D 81
					39 00 00 00 00 00 03 F0 A5 A5
					/* OPEC code */
					39 00 00 40 00 00 03 F0 5A 5A
					39 00 00 40 00 00 04 B0 00 52 1F
					39 00 00 40 00 00 02 1F 02
					39 00 00 40 00 00 04 B0 00 53 1F
					39 00 00 40 00 00 5F 1F
						07 01 00 02 B9 02 BA 07 A2 07 AA 12 C0 12 C1 1A
						BA 1B C0 1F E0 00 53 00 C3 03 43 07 A0 07 A1 07
						A2 07 A6 07 A8 07 AA 07 AC 07 AE 07 B0 07 B2 07
						B4 07 B6 00 03 00 A4 00 C0 00 D1 01 86 03 FF 07
						FF 30 30 35 40 35 30 40 40 35 80 80 80 0A 0F 14
						18 1E 3A 78 80 80 80 80 80 80 80 80 01 B1
					39 00 00 40 00 00 04 B0 00 78 BD
					39 00 00 40 00 00 02 BD 10
					39 00 00 00 00 00 02 F7 0F
					39 00 00 00 00 00 03 F0 A5 A5
					/* Display On */
					05 00 00 00 00 00 02 29 00
					39 00 00 40 00 00 03 F0 5A 5A
					39 00 00 40 00 00 02 BD 23   /* Control in Auto mode */
					39 00 00 40 00 00 04 B0 00 14 BD
					39 00 00 40 00 00 02 BD 77        /* 0B:10hz, 77:1hz */
					39 00 00 40 00 00 02 F7 0F
					39 00 00 00 00 00 03 F0 A5 A5
				];
				qcom,mdss-dsi-on-command-state = "dsi_lp_mode";

				qcom,mdss-dsi-nolp-command = [
					39 00 00 40 00 00 03 F0 5A 5A
					15 00 00 40 00 00 02 53 20
					39 00 00 40 00 00 03 51 00 00
					39 00 00 00 22 00 03 F0 A5 A5
					/* FIX TE ON */
					39 00 00 40 00 00 03 F0 5A 5A
					15 00 00 40 00 00 02 B9 41
					39 00 00 40 00 00 04 B0 00 06 B9
					39 00 00 40 00 00 07 B9 0C 9E 0C 9E 00 1D
					39 00 00 40 00 00 02 F7 0F
					39 00 00 40 00 00 03 F0 A5 A5
					/* 1Hz Setting(force increasing on) */
					39 00 00 40 00 00 03 F0 5A 5A
					39 00 00 40 00 00 04 B0 03 37 65
					15 00 00 40 00 00 02 65 04
					39 00 00 40 00 00 04 B0 00 08 CB
					39 00 00 40 00 00 02 CB 12
					39 00 00 40 00 00 03 BD 21 0F    /* Auto mode On */
					39 00 00 40 00 00 04 B0 00 10 BD
					39 00 00 40 00 00 02 BD 00
					39 00 00 40 00 00 04 B0 00 21 BD
					39 00 00 40 00 00 0F BD 01 00 02 00 03 00 04 00 05 00 07 00 0B 00
					39 00 00 40 00 00 04 B0 00 61 BD
					39 00 00 40 00 00 0A BD 01 00 02 00 03 00 04 00 1D
					39 00 00 40 00 00 04 B0 00 12 BD
					39 00 00 40 00 00 02 BD 00
					39 00 00 40 00 00 02 BD 23   /* Control in Auto mode */
					39 00 00 40 00 00 04 B0 00 14 BD
					39 00 00 40 00 00 02 BD 77        /* 0B:10hz, 77:1hz */
					39 00 00 40 00 00 04 B0 00 16 BD
					39 00 00 40 00 00 03 BD 02 00
					39 00 00 40 00 00 02 F7 0F
					39 00 00 00 00 00 03 F0 A5 A5
				];
				qcom,mdss-dsi-nolp-command-update = <0x51 2 2>;
				qcom,mdss-dsi-nolp-command-state = "dsi_lp_mode";

				mi,mdss-dsi-doze-hbm-command = [
					/* 120Hz Setting(force increasing off) */
					39 00 00 40 00 00 03 F0 5A 5A
					39 00 00 40 00 00 04 B0 00 08 CB
					39 00 00 40 00 00 02 CB 12
					39 00 00 40 00 00 03 BD 21 8F
					39 00 00 40 00 00 04 B0 00 10 BD
					39 00 00 40 00 00 02 BD 00
					39 00 00 40 00 00 04 B0 00 21 BD
					39 00 00 40 00 00 0F BD 10 00 20 00 30 00 40 00 50 00 70 00 B0 00
					39 00 00 40 00 00 04 B0 00 61 BD
					39 00 00 40 00 00 0A BD 04 00 08 00 0C 00 10 00 74
					39 00 00 40 00 00 04 B0 00 12 BD
					39 00 00 40 00 00 02 BD 01
					39 00 00 40 00 00 04 B0 00 16 BD
					39 00 00 40 00 00 03 BD 00 00    /* Step delay */
					39 00 00 40 00 00 02 BD 21       /* Manual mode */
					39 00 00 40 00 00 02 60 00       /* 0x00:120Hz, 0x01:60Hz, 0x03:30Hz, 0x07:10Hz */
					39 00 00 40 00 00 02 F7 0F
					39 00 00 00 09 00 03 F0 A5 A5
					/* AOD setting */
					39 00 00 20 00 00 03 51 07 0A    /* Dynamic update, index 18 */
					39 00 00 40 00 00 03 F0 5A 5A
					39 00 00 40 00 00 02 BB 31
					39 00 00 40 00 00 02 F7 0F
					39 00 00 40 00 00 02 53 24
					39 00 00 00 00 00 03 51 07 FE
				];
				mi,mdss-dsi-doze-hbm-command-update = <0x51 18 2>;
				mi,mdss-dsi-doze-hbm-command-state = "dsi_lp_mode";
				mi,mdss-dsi-doze-lbm-command = [
					/* 120Hz Setting(force increasing off) */
					39 00 00 40 00 00 03 F0 5A 5A
					39 00 00 40 00 00 04 B0 00 08 CB
					39 00 00 40 00 00 02 CB 12
					39 00 00 40 00 00 03 BD 21 8F
					39 00 00 40 00 00 04 B0 00 10 BD
					39 00 00 40 00 00 02 BD 00
					39 00 00 40 00 00 04 B0 00 21 BD
					39 00 00 40 00 00 0F BD 10 00 20 00 30 00 40 00 50 00 70 00 B0 00
					39 00 00 40 00 00 04 B0 00 61 BD
					39 00 00 40 00 00 0A BD 04 00 08 00 0C 00 10 00 74
					39 00 00 40 00 00 04 B0 00 12 BD
					39 00 00 40 00 00 02 BD 01
					39 00 00 40 00 00 04 B0 00 16 BD
					39 00 00 40 00 00 03 BD 00 00    /* Step delay */
					39 00 00 40 00 00 02 BD 21       /* Manual mode */
					39 00 00 40 00 00 02 60 00       /* 0x00:120Hz, 0x01:60Hz, 0x03:30Hz, 0x07:10Hz */
					39 00 00 40 00 00 02 F7 0F
					39 00 00 00 09 00 03 F0 A5 A5
					/* AOD setting */
					39 00 00 20 00 00 03 51 07 0A    /* Dynamic update, index 18 */
					39 00 00 40 00 00 03 F0 5A 5A
					39 00 00 40 00 00 02 BB 31
					39 00 00 40 00 00 02 F7 0F
					39 00 00 40 00 00 02 53 24
					39 00 00 00 00 00 03 51 00 F6
				];
				mi,mdss-dsi-doze-lbm-command-update = <0x51 18 2>;
				mi,mdss-dsi-doze-lbm-command-state = "dsi_lp_mode";

				mi,mdss-dsi-doze-hbm-nolp-command = [
					/* aod off */
					39 00 00 40 00 00 02 53 20
					39 00 00 00 00 00 03 51 00 F5
					/* 16 pulse on */
					39 00 00 40 00 00 03 F0 5A 5A
					39 00 00 40 00 00 04 B0 03 37 65
					15 00 00 40 00 00 02 65 04
					39 00 00 40 00 00 03 BD 21 8F
					39 00 00 40 00 00 04 B0 00 21 BD
					39 00 00 40 00 00 0F BD 10 00 20 00 30 00 40 00 50 00 70 00 B0 00
					39 00 00 40 00 00 04 B0 00 0C 63
					39 00 00 40 00 00 02 63 20
					39 00 00 40 00 00 03 BD 21 8F
					15 00 00 40 00 00 02 F7 0F
					39 00 00 00 00 00 03 F0 A5 A5
				];
				mi,mdss-dsi-doze-hbm-nolp-command-state = "dsi_lp_mode";

				mi,mdss-dsi-doze-lbm-nolp-command = [
					/* aod off */
					15 00 00 40 00 00 02 53 20
					39 00 00 00 00 00 03 51 00 14
					/* 16 pulse on */
					39 00 00 40 00 00 03 F0 5A 5A
					39 00 00 40 00 00 04 B0 03 37 65
					15 00 00 40 00 00 02 65 04
					39 00 00 40 00 00 03 BD 21 8F
					39 00 00 40 00 00 04 B0 00 21 BD
					39 00 00 40 00 00 0F BD 10 00 20 00 30 00 40 00 50 00 70 00 B0 00
					39 00 00 40 00 00 04 B0 00 0C 63
					39 00 00 40 00 00 02 63 20
					39 00 00 40 00 00 03 BD 21 8F
					15 00 00 40 00 00 02 F7 0F
					39 00 00 00 00 00 03 F0 A5 A5
				];
				mi,mdss-dsi-doze-lbm-nolp-command-state = "dsi_lp_mode";
				mi,mdss-dsi-local-hbm-hlpm-white-1000nit-command = [
					/* nolp */
					39 00 00 40 00 00 03 F0 5A 5A
					39 00 00 40 00 00 02 53 20
					39 00 00 00 22 00 03 F0 A5 A5
					/* Local HBM setting */
					39 00 00 40 00 00 03 F0 5A 5A
					39 00 00 40 00 00 04 B0 01 DC 1F
					39 00 00 40 00 00 10 1F 02 00 00 00 00 24
						09 5D 35 FA 7C 2D 09 ED 7B
					39 00 00 40 00 00 04 B0 02 AC 66
					39 00 00 40 00 00 03 66 0F FF
					39 00 00 40 00 00 04 B0 01 6D 66
					39 00 00 40 00 00 13 66 00 40 14 02 90 52
						0A 41 48 1C 27 FF FF FF FF FF FF FF
					39 00 00 40 00 00 04 B0 01 59 66
					39 00 00 40 00 00 06 66 09 8B 40 A0 54 		/* 1300 nit*/
					39 00 00 40 00 00 04 B0 01 B5 66
					39 00 00 40 00 00 37 66 14 F1 F9 2B 23 B6 51
						46 F4 80 08 00 80 08 00 80 08 00 14 F1 F9 2B
						23 B6 51 46 F4 80 08 00 80 08 00 80 08 00 14
						F1 F9 2B 23 B6 51 46 F4 80 08 00 80 08 00 80 08 00
					39 00 00 40 00 00 04 B0 01 EB 66
					39 00 00 40 00 00 37 66 14 F1 F9 2B 23 B6 51
						46 F4 80 08 00 80 08 00 80 08 00 14 F1 F9 2B
						23 B6 51 46 F4 80 08 00 80 08 00 80 08 00 14
						F1 F9 2B 23 B6 51 46 F4 80 08 00 80 08 00 80 08 00
					39 00 00 40 00 00 04 B0 01 EB 66
					39 00 00 40 00 00 37 66 14 F1 F9 2B 23 B6 51
						46 F4 80 08 00 80 08 00 80 08 00 14 F1 F9 2B
						23 B6 51 46 F4 80 08 00 80 08 00 80 08 00 14
						F1 F9 2B 23 B6 51 46 F4 80 08 00 80 08 00 80 08 00
					39 00 00 40 00 00 02 53 30   /* 0x30 Local HBM transition */
					/* 16 pulse off */
					39 00 00 40 00 00 04 B0 00 0D 63
					39 00 00 40 00 00 02 63 08
					39 00 00 40 00 00 04 B0 00 0C 63
					39 00 00 40 00 00 02 63 20
					39 00 00 40 00 00 04 B0 03 37 65
					39 00 00 40 00 00 02 65 01
					39 00 00 40 00 00 03 BD 21 82
					39 00 00 40 00 00 04 B0 00 21 BD
					39 00 00 40 00 00 02 53 30
					39 00 00 40 00 00 02 F7 0F
					39 00 00 00 10 00 03 F0 A5 A5
				];
				mi,mdss-dsi-local-hbm-hlpm-white-1000nit-command-state = "dsi_hs_mode";

				mi,mdss-dsi-local-hbm-hlpm-white-110nit-command = [
					/* nolp */
					39 00 00 40 00 00 03 F0 5A 5A
					39 00 00 40 00 00 02 53 20
					39 00 00 00 22 00 03 F0 A5 A5
					/* Local HBM setting */
					39 00 00 40 00 00 03 F0 5A 5A
					39 00 00 40 00 00 04 B0 01 DC 1F
					39 00 00 40 00 00 10 1F 02 00 00 00 00 24
						09 5D 35 FA 7C 2D 09 ED 7B
					39 00 00 40 00 00 04 B0 02 AC 66
					39 00 00 40 00 00 03 66 0F FF
					39 00 00 40 00 00 04 B0 01 6D 66
					39 00 00 40 00 00 13 66 00 40 14 02 90 52
						0A 41 48 1C 27 FF FF FF FF FF FF FF
					39 00 00 40 00 00 04 B0 01 59 66
					39 00 00 40 00 00 06 66 06 67 C9 7E F5 		/* 250 nit*/
					39 00 00 40 00 00 04 B0 01 B5 66
					39 00 00 40 00 00 37 66 14 F1 F9 2B 23 B6 51
						46 F4 80 08 00 80 08 00 80 08 00 14 F1 F9 2B
						23 B6 51 46 F4 80 08 00 80 08 00 80 08 00 14
						F1 F9 2B 23 B6 51 46 F4 80 08 00 80 08 00 80 08 00
					39 00 00 40 00 00 04 B0 01 EB 66
					39 00 00 40 00 00 37 66 14 F1 F9 2B 23 B6 51
						46 F4 80 08 00 80 08 00 80 08 00 14 F1 F9 2B
						23 B6 51 46 F4 80 08 00 80 08 00 80 08 00 14
						F1 F9 2B 23 B6 51 46 F4 80 08 00 80 08 00 80 08 00
					39 00 00 40 00 00 04 B0 01 EB 66
					39 00 00 40 00 00 37 66 14 F1 F9 2B 23 B6 51
						46 F4 80 08 00 80 08 00 80 08 00 14 F1 F9 2B
						23 B6 51 46 F4 80 08 00 80 08 00 80 08 00 14
						F1 F9 2B 23 B6 51 46 F4 80 08 00 80 08 00 80 08 00
					39 00 00 40 00 00 02 53 30   /* 0x30 Local HBM transition */
					/* 16 pulse off */
					39 00 00 40 00 00 04 B0 00 0D 63
					39 00 00 40 00 00 02 63 08
					39 00 00 40 00 00 04 B0 00 0C 63
					39 00 00 40 00 00 02 63 20
					39 00 00 40 00 00 04 B0 03 37 65
					39 00 00 40 00 00 02 65 01
					39 00 00 40 00 00 03 BD 21 82
					39 00 00 40 00 00 04 B0 00 21 BD
					39 00 00 40 00 00 02 53 30
					39 00 00 40 00 00 02 F7 0F
					39 00 00 00 10 00 03 F0 A5 A5
				];
				mi,mdss-dsi-local-hbm-hlpm-white-110nit-command-state = "dsi_hs_mode";
				mi,mdss-dsi-hbm-on-command = [
					39 00 00 40 00 00 03 F0 5A 5A
					/* ELVSS DIM ON */
					39 00 00 40 00 00 04 B0 00 0C 63
					15 00 00 40 00 00 02 63 30
					/* Dimming On and wait one frame*/
					15 00 00 40 00 00 02 53 28    /* Dynamic update, index 3 */
					/* WRDISBV */
					39 00 00 00 11 00 03 51 07 FF   /* Dynamic update, index 4 */
					/* HBM Mode Setting */
					39 00 00 40 00 00 04 B0 00 01 49
					15 00 00 40 00 00 02 49 00
					39 00 00 00 00 00 03 F0 A5 A5
				];
				/* <mipi_address  update_index  update_length> */
				mi,mdss-dsi-hbm-on-command-update = <0x53 3 1>,<0x51 4 2>;
				mi,mdss-dsi-hbm-on-command-state = "dsi_lp_mode";
				mi,mdss-dsi-hbm-off-command = [
					39 00 00 60 00 00 03 F0 5A 5A
					/* ELVSS DIM OFF */
					39 00 00 60 00 00 04 B0 00 0C 63
					39 00 00 60 00 00 02 63 20
					39 00 00 60 00 00 02 53 20   /* Dynamic update, index 3 */
					39 00 00 20 05 00 03 51 07 FF
					39 00 00 60 00 00 03 F0 5A 5A
					/* HBM Mode Setting */
					39 00 00 60 00 00 04 B0 00 01 49
					39 00 00 60 00 00 02 49 01
					39 00 00 60 00 00 03 51 07 FF    /* Dynamic update, index 8 */
					39 00 00 20 00 00 03 F0 A5 A5
				];
				/* <mipi_address  update_index  update_length> */
				mi,mdss-dsi-hbm-off-command-update = <0x53 3 1>,<0x51 8 2>;
				mi,mdss-dsi-hbm-off-command-state = "dsi_lp_mode";

				mi,mdss-dsi-panel-em-cycle-16pulse-on-command = [
					39 00 00 40 00 00 03 F0 5A 5A
					39 00 00 40 00 00 03 BD 21 8F     /* Dynamic update, index 1 */
					39 00 00 40 00 00 04 B0 00 21 BD
					39 00 00 40 00 00 0F BD 10 00 20 00 30 00 40 00 50 00 70 00 B0 00  /* Dynamic update, index 3 */
					39 00 00 40 00 00 04 B0 00 0C 63
					39 00 00 40 00 00 02 63 20
					39 00 00 40 00 00 04 B0 03 37 65
					15 00 00 40 00 00 02 65 04
					39 00 00 40 00 00 03 BD 21 8F    /* Dynamic update, index 8 */
					39 00 00 40 00 00 03 51 01 48    /* Dynamic update, index 9 */
					15 00 00 40 00 00 02 F7 0F
					39 00 00 00 08 00 03 F0 A5 A5
				];
				mi,mdss-dsi-panel-em-cycle-16pulse-on-command-update = <0xBD 1 2>,<0xBD 3 14>,<0xBD 8 2>,<0x51 9 2>;
				mi,mdss-dsi-panel-em-cycle-16pulse-on-command-state = "dsi_lp_mode";

				mi,mdss-dsi-panel-em-cycle-16pulse-off-command = [
					39 00 00 40 00 00 03 F0 5A 5A
					39 00 00 40 00 00 03 BD 21 82    /* Dynamic update, index 1 */
					39 00 00 40 00 00 04 B0 00 21 BD
					39 00 00 40 00 00 0F BD 03 00 06 00 09 00 0C 00 0F 00 15 00 21 00  /* Dynamic update, index 3 */
					39 00 00 40 00 00 04 B0 00 0C 63
					39 00 00 40 00 00 02 63 20
					39 00 00 40 00 00 04 B0 03 37 65
					15 00 00 40 00 00 02 65 01
					39 00 00 40 00 00 03 BD 21 82   /* Dynamic update, index 8 */
					39 00 00 40 00 00 03 51 01 49   /* Dynamic update, index 9 */
					15 00 00 40 00 00 02 F7 0F
					39 00 00 00 08 00 03 F0 A5 A5
				];
				mi,mdss-dsi-panel-em-cycle-16pulse-off-command-update =<0xBD 1 2>,<0xBD 3 14>,<0xBD 8 2>,<0x51 9 2>;
				mi,mdss-dsi-panel-em-cycle-16pulse-off-command-state = "dsi_lp_mode";

				qcom,compression-mode = "dsc";
				qcom,mdss-dsc-version = <0x12>;
				qcom,mdss-dsc-slice-height = <25>;
				qcom,mdss-dsc-slice-width = <720>;
				qcom,mdss-dsc-slice-per-pkt = <2>;
				qcom,mdss-dsc-bit-per-component = <10>;
				qcom,mdss-dsc-bit-per-pixel = <8>;
				qcom,mdss-dsc-block-prediction-enable;
			};

